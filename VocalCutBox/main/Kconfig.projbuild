## VocalCutBox/main/Kconfig.projbuild
```kconfig
menu "伴伴"
config BANBAN_BOARD_SPEAKER_TEST
    bool "板载ES8389喇叭对照测试（停用USB/BT）"
    default n
config BANBAN_USB_UAC2
    bool "使用可复用UAC2 Host组件（全速播放）"
    default y
config BANBAN_BT_AUDIO
    bool "启用实验性 A2DP 输入（P1验收后使用）"
    default n
    depends on BT_A2DP_ENABLE
endmenu
```

## VocalCutBox/sdkconfig.defaults
```kconfig
CONFIG_IDF_TARGET="esp32s31"
CONFIG_ESPTOOLPY_FLASHSIZE_16MB=y
CONFIG_ESPTOOLPY_FLASHMODE_DIO=y
CONFIG_ESP_MAIN_TASK_STACK_SIZE=8192

# CX31993复合设备配置描述符超过USB Host默认上限。
CONFIG_USB_HOST_CONTROL_TRANSFER_MAX_SIZE=4096
```
